## nemu/configs/riscv32-nemu_defconfig
```kconfig
# CONFIG_TRACE is not set
CONFIG_DIFFTEST=y
CONFIG_MSIZE=0x08000000
CONFIG_DEVICE=y
```

## nemu/configs/riscv32-npc_defconfig
```kconfig
CONFIG_TARGET_SHARE=y
# CONFIG_TRACE is not set
# CONFIG_YSYXSOC is not set
CONFIG_MBASE=0x80000000
CONFIG_MSIZE=0x70000000
CONFIG_PC_RESET_OFFSET=0x0
# CONFIG_MEM_RANDOM is not set
```

## nemu/configs/riscv32-ysyxsoc_defconfig
```kconfig
CONFIG_TARGET_SHARE=y
# CONFIG_TRACE is not set
CONFIG_YSYXSOC=y
# CONFIG_MEM_RANDOM is not set
```
